## meta-rauc-rz/conf/layer.conf
```bitbake
# We have a conf and classes directory, add to BBPATH
BBPATH .= ":${LAYERDIR}"

# We have recipes-* directories, add to BBFILES
BBFILES += "${LAYERDIR}/recipes-*/*/*.bb \
            ${LAYERDIR}/recipes-*/*/*.bbappend"

BBFILE_COLLECTIONS += "meta-rauc-rz"
BBFILE_PATTERN_meta-rauc-rz = "^${LAYERDIR}/"
BBFILE_PRIORITY_meta-rauc-rz = "6"

LAYERDEPENDS_meta-rauc-rz = "core rauc meta-rz-bsp"
LAYERSERIES_COMPAT_meta-rauc-rz = "whinlatter"

RAUC_KEY_FILE ?= "${LAYERDIR}/../files/rauc-example-keys/development-1.key.pem"
RAUC_CERT_FILE ?= "${LAYERDIR}/../files/rauc-example-keys/development-1.cert.pem"
RAUC_KEYRING_FILE ?= "${LAYERDIR}/../files/rauc-example-keys/ca.cert.pem"
```
